/*-----------------------------------------------------------------------------
Licensed under the BSD 2-clause license:
Copyright (c) 2017 Masaki Ota / MagurosanTeam. All rights reserved.

Redistribution and use in source and binary forms, with or without
modification, are permitted provided that the following conditions are met:

- Redistributions of source code must retain the above copyright notice,
  this list of conditions and the following disclaimer.
- Redistributions in binary form must reproduce the above copyright notice,
  this list of conditions and the following disclaimer in the documentation
  and/or other materials provided with the distribution.

THIS SOFTWARE IS PROVIDED BY THE COPYRIGHT HOLDERS AND CONTRIBUTORS "AS IS"
AND ANY EXPRESS OR IMPLIED WARRANTIES, INCLUDING, BUT NOT LIMITED TO, THE
IMPLIED WARRANTIES OF MERCHANTABILITY AND FITNESS FOR A PARTICULAR PURPOSE
ARE DISCLAIMED. IN NO EVENT SHALL THE COPYRIGHT HOLDER OR CONTRIBUTORS BE
LIABLE FOR ANY DIRECT, INDIRECT, INCIDENTAL, SPECIAL, EXEMPLARY, OR
CONSEQUENTIAL DAMAGES (INCLUDING, BUT NOT LIMITED TO, PROCUREMENT OF
SUBSTITUTE GOODS OR SERVICES; LOSS OF USE, DATA, OR PROFITS; OR BUSINESS
INTERRUPTION) HOWEVER CAUSED AND ON ANY THEORY OF LIABILITY, WHETHER IN
CONTRACT, STRICT LIABILITY, OR TORT (INCLUDING NEGLIGENCE OR OTHERWISE)
ARISING IN ANY WAY OUT OF THE USE OF THIS SOFTWARE, EVEN IF ADVISED OF THE
POSSIBILITY OF SUCH DAMAGE.
----------------------------------------------------------------------------*/
/*----------------------------------------------------------------------------
Charactor, Kurei Kei(Pronama-chan):
Copyright (c) Pronama LLC. All rights reserved.

using guideline: 
  http://pronama.azurewebsites.net/pronama/guideline/

Pronama-chan monotone icons:
  https://blogs.msdn.microsoft.com/shintak/2013/01/01/2773/
----------------------------------------------------------------------------*/

#include <Arduboy2.h>
#include "Keyboard.h"
#include <stdint.h>
#include <avr/pgmspace.h>

Arduboy2 arduboy;
#define WIDTH 128
#define HEIGHT 64

// pronama-chan background image
const unsigned char image[] PROGMEM = {
  0xff, 0xff, 0xff, 0xff, 0xdf, 0xdf, 0x1f, 0x1f, 
  0xdf, 0xdf, 0x9f, 0xbf, 0x0f, 0x0f, 0xaf, 0x8f, 
  0x9f, 0xff, 0xff, 0x1f, 0x1f, 0xff, 0xff, 0xff, 
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  0x3f, 0xff, 0xff, 0xff, 0xff, 0xff, 0xff, 0xff,   
};


#define NUM_WIDTH 16
#define NUM_HEIGHT 27
const unsigned char numbers[][64] PROGMEM = {
  {//0
    0x03, 0x02, 0x04, 0xf8, 0xf8, 0xf8, 0xf8, 0xf8, 0xf8, 0xf8, 0xf8, 0xf8, 0xf8, 0x04, 0x02, 0x03, 
    0x20, 0x20, 0x70, 0xff, 0xff, 0xff, 0xff, 0xff, 0xff, 0xff, 0xff, 0xff, 0xff, 0x70, 0x20, 0x20, 
    0x00, 0x00, 0x00, 0xff, 0xff, 0xff, 0xff, 0xff, 0xff, 0xff, 0xff, 0xff, 0xff, 0x00, 0x00, 0x00, 
    0x06, 0x02, 0x01, 0x00, 0x00, 0x00, 0x00, 0x00, 0x00, 0x00, 0x00, 0x00, 0x00, 0x01, 0x02, 0x06, 
  },
  {//1
    0xff, 0xff, 0xff, 0xff, 0xff, 0xff, 0xff, 0xff, 0xff, 0xff, 0xff, 0xff, 0xff, 0x07, 0x03, 0x03, 
    0xff, 0xff, 0xff, 0xff, 0xff, 0xff, 0xff, 0xff, 0xff, 0xff, 0xff, 0xff, 0xff, 0x70, 0x20, 0x20, 
    0xff, 0xff, 0xff, 0xff, 0xff, 0xff, 0xff, 0xff, 0xff, 0xff, 0xff, 0xff, 0xff, 0x00, 0x00, 0x00, 
    0x07, 0x07, 0x07, 0x07, 0x07, 0x07, 0x07, 0x07, 0x07, 0x07, 0x07, 0x07, 0x07, 0x07, 0x06, 0x06, 
  }, 
  {//2
    0xff, 0xfe, 0xfc, 0xf8, 0xf8, 0xf8, 0xf8, 0xf8, 0xf8, 0xf8, 0xf8, 0xf8, 0xf8, 0x04, 0x02, 0x03, 
    0x3f, 0x3f, 0x5f, 0x8f, 0x8f, 0x8f, 0x8f, 0x8f, 0x8f, 0x8f, 0x8f, 0x8f, 0x8f, 0xd0, 0xe0, 0xe0, 
    0x00, 0x00, 0x00, 0xff, 0xff, 0xff, 0xff, 0xff, 0xff, 0xff, 0xff, 0xff, 0xff, 0xff, 0xff, 0xff, 
    0x06, 0x02, 0x01, 0x00, 0x00, 0x00, 0x00, 0x00, 0x00, 0x00, 0x00, 0x00, 0x00, 0x01, 0x03, 0x07,       
  },
  {//3
    0xff, 0xfe, 0xfc, 0xf8, 0xf8, 0xf8, 0xf8, 0xf8, 0xf8, 0xf8, 0xf8, 0xf8, 0xf8, 0x04, 0x02, 0x03, 
    0xff, 0xff, 0xdf, 0x8f, 0x8f, 0x8f, 0x8f, 0x8f, 0x8f, 0x8f, 0x8f, 0x8f, 0x8f, 0x50, 0x20, 0x20, 
    0xff, 0xff, 0xff, 0xff, 0xff, 0xff, 0xff, 0xff, 0xff, 0xff, 0xff, 0xff, 0xff, 0x00, 0x00, 0x00, 
    0x07, 0x03, 0x01, 0x00, 0x00, 0x00, 0x00, 0x00, 0x00, 0x00, 0x00, 0x00, 0x00, 0x01, 0x02, 0x06,     
  },
  {//4
    0x03, 0x03, 0x07, 0xff, 0xff, 0xff, 0xff, 0xff, 0xff, 0xff, 0xff, 0xff, 0xff, 0x07, 0x03, 0x03, 
    0xe0, 0xe0, 0xd0, 0x8f, 0x8f, 0x8f, 0x8f, 0x8f, 0x8f, 0x8f, 0x8f, 0x8f, 0x8f, 0x50, 0x20, 0x20, 
    0xff, 0xff, 0xff, 0xff, 0xff, 0xff, 0xff, 0xff, 0xff, 0xff, 0xff, 0xff, 0xff, 0x00, 0x00, 0x00, 
    0x07, 0x07, 0x07, 0x07, 0x07, 0x07, 0x07, 0x07, 0x07, 0x07, 0x07, 0x07, 0x07, 0x07, 0x06, 0x06,
  },
  {//5
    0x03, 0x02, 0x04, 0xf8, 0xf8, 0xf8, 0xf8, 0xf8, 0xf8, 0xf8, 0xf8, 0xf8, 0xf8, 0xfc, 0xfe, 0xff, 
    0xe0, 0xe0, 0xd0, 0x8f, 0x8f, 0x8f, 0x8f, 0x8f, 0x8f, 0x8f, 0x8f, 0x8f, 0x8f, 0x5f, 0x3f, 0x3f, 
    0xff, 0xff, 0xff, 0xff, 0xff, 0xff, 0xff, 0xff, 0xff, 0xff, 0xff, 0xff, 0xff, 0x00, 0x00, 0x00, 
    0x07, 0x03, 0x01, 0x00, 0x00, 0x00, 0x00, 0x00, 0x00, 0x00, 0x00, 0x00, 0x00, 0x01, 0x02, 0x06,   
  },
  {//6
    0x03, 0x02, 0x04, 0xf8, 0xf8, 0xf8, 0xf8, 0xf8, 0xf8, 0xf8, 0xf8, 0xf8, 0xf8, 0xfc, 0xfe, 0xff, 
    0x20, 0x20, 0x50, 0x8f, 0x8f, 0x8f, 0x8f, 0x8f, 0x8f, 0x8f, 0x8f, 0x8f, 0x8f, 0x5f, 0x3f, 0x3f, 
    0x00, 0x00, 0x00, 0xff, 0xff, 0xff, 0xff, 0xff, 0xff, 0xff, 0xff, 0xff, 0xff, 0x00, 0x00, 0x00, 
    0x06, 0x02, 0x01, 0x00, 0x00, 0x00, 0x00, 0x00, 0x00, 0x00, 0x00, 0x00, 0x00, 0x01, 0x02, 0x06, 
  },
  {//7
    0x03, 0x02, 0x04, 0xf8, 0xf8, 0xf8, 0xf8, 0xf8, 0xf8, 0xf8, 0xf8, 0xf8, 0xf8, 0x04, 0x02, 0x03, 
    0xe0, 0xe0, 0xf0, 0xff, 0xff, 0xff, 0xff, 0xff, 0xff, 0xff, 0xff, 0xff, 0xff, 0x70, 0x20, 0x20, 
    0xff, 0xff, 0xff, 0xff, 0xff, 0xff, 0xff, 0xff, 0xff, 0xff, 0xff, 0xff, 0xff, 0x00, 0x00, 0x00, 
    0x07, 0x07, 0x07, 0x07, 0x07, 0x07, 0x07, 0x07, 0x07, 0x07, 0x07, 0x07, 0x07, 0x07, 0x06, 0x06, 
  },
  {//8
    0x03, 0x02, 0x04, 0xf8, 0xf8, 0xf8, 0xf8, 0xf8, 0xf8, 0xf8, 0xf8, 0xf8, 0xf8, 0x04, 0x02, 0x03, 
    0x20, 0x20, 0x50, 0x8f, 0x8f, 0x8f, 0x8f, 0x8f, 0x8f, 0x8f, 0x8f, 0x8f, 0x8f, 0x50, 0x20, 0x20, 
    0x00, 0x00, 0x00, 0xff, 0xff, 0xff, 0xff, 0xff, 0xff, 0xff, 0xff, 0xff, 0xff, 0x00, 0x00, 0x00, 
    0x06, 0x02, 0x01, 0x00, 0x00, 0x00, 0x00, 0x00, 0x00, 0x00, 0x00, 0x00, 0x00, 0x01, 0x02, 0x06, 
  }, 
  {//9
    0x03, 0x02, 0x04, 0xf8, 0xf8, 0xf8, 0xf8, 0xf8, 0xf8, 0xf8, 0xf8, 0xf8, 0xf8, 0x04, 0x02, 0x03, 
    0xe0, 0xe0, 0xd0, 0x8f, 0x8f, 0x8f, 0x8f, 0x8f, 0x8f, 0x8f, 0x8f, 0x8f, 0x8f, 0x50, 0x20, 0x20, 
    0xff, 0xff, 0xff, 0xff, 0xff, 0xff, 0xff, 0xff, 0xff, 0xff, 0xff, 0xff, 0xff, 0x00, 0x00, 0x00, 
    0x07, 0x03, 0x01, 0x00, 0x00, 0x00, 0x00, 0x00, 0x00, 0x00, 0x00, 0x00, 0x00, 0x01, 0x02, 0x06,   
  }
};

static bool g_is_timer_active;              // Current play state.
static uint32_t g_start_time;         // Start time when timer is running
static uint32_t g_elapsed_time;       // Elapsed time
static uint32_t g_displayed_time;          // Displayed Time

void setup()
{
  // initialize mouse control:
  Keyboard.begin();
   
  arduboy.begin();
  arduboy.setFrameRate(60);
  arduboy.clear();
  arduboy.drawBitmap(0, 0, image, WIDTH, HEIGHT, 1);
  arduboy.display();

  // And reset the timer
  g_is_timer_active = false;
  g_start_time = 0;
  g_elapsed_time = 0;
  g_displayed_time = 0;
}

void loop() {
  // up, down, left, right keys
  if (arduboy.pressed(RIGHT_BUTTON)) { 
    Keyboard.press(KEY_RIGHT_ARROW); 
  } else if (arduboy.pressed(LEFT_BUTTON)) { 
    Keyboard.press(KEY_LEFT_ARROW); 
  } else if (arduboy.pressed(UP_BUTTON)) { 
    Keyboard.press(KEY_UP_ARROW); 
  } else if (arduboy.pressed(DOWN_BUTTON)){ 
    Keyboard.press(KEY_DOWN_ARROW); 
  } else {
    Keyboard.releaseAll();
  }
  
  long t;
  if (!arduboy.nextFrame()) return;

  if (g_is_timer_active == false) {
    if (arduboy.pressed(A_BUTTON)) {
      g_start_time = millis();
      g_is_timer_active = true;
      updateDisplay();
      delay(200);
    } else if (arduboy.pressed(B_BUTTON)) {
      if (g_elapsed_time == 0) {
        updateDisplay();
      } else {
        g_elapsed_time = 0;
      }
    }
    t = g_elapsed_time;
  } else { // timer active
    t = g_elapsed_time + millis() - g_start_time;
    if (arduboy.pressed(A_BUTTON)) {
      g_elapsed_time = t;
      g_start_time = 0;
      g_is_timer_active = false;
      delay(200);
    } else if (arduboy.pressed(B_BUTTON)) {
      updateDisplay();
    }
  }

  t /= 100;
  if (t != g_displayed_time) {
    g_displayed_time = t;
    updateDisplay();
  } 
}

static void updateDisplay()
{  
  if (g_is_timer_active == false && g_elapsed_time == 0) {
    arduboy.clear();
    arduboy.drawBitmap(0, 0, image, WIDTH, HEIGHT, 1);
  } else {
    uint32_t t = 3000 - min(3000, g_displayed_time);
    int f = t % 10;
    t /= 10;
    int s = t % 60;
    t /= 60;
    int m = t % 60;

    enum { 
      xMinute = 6, xSec10 = 32, xSec1 = 54, 
      yCommon = 21
    };
    arduboy.fillRect(xMinute, yCommon, NUM_WIDTH, NUM_HEIGHT, 0);
    arduboy.drawBitmap(xMinute, yCommon, numbers[m%10], NUM_WIDTH, NUM_HEIGHT, 1);
    arduboy.fillRect(xSec10, yCommon, NUM_WIDTH, NUM_HEIGHT, 0);
    arduboy.drawBitmap(xSec10, yCommon, numbers[s/10], NUM_WIDTH, NUM_HEIGHT, 1);
    arduboy.fillRect(xSec1, yCommon, NUM_WIDTH, NUM_HEIGHT, 0);
    arduboy.drawBitmap(xSec1,yCommon, numbers[s%10], NUM_WIDTH, NUM_HEIGHT, 1);
  }
  arduboy.display();
}

